## Rewizje/EGRLab-v1/firmware/main/Kconfig.projbuild
```kconfig
menu "EGRLab"
config EGR_ACTIVE_TEST
    bool "Enable TEST after hardware acceptance and calibration"
    default n
config EGR_SAMPLE_HZ
    int "Requested sample rate; qualify timing on hardware"
    range 100 20000
    default 2000
endmenu
```

## Rewizje/EGRLab-v2/firmware/main/Kconfig.projbuild
```kconfig
menu "EGRLab"
config EGR_ACTIVE_TEST
    bool "Wlacz TEST po odbiorze sprzetu i kalibracji"
    default n
config EGR_SAMPLE_HZ
    int "Zadana czestotliwosc probkowania; kwalifikuj czasy na sprzecie"
    range 100 20000
    default 2000
config EGR_WIFI_UI
    bool "SoftAP z podgladem i przyciskami na telefonie"
    default n
    depends on EGR_ACTIVE_TEST
config EGR_WIFI_SSID
    string "SSID punktu dostepowego"
    default "EGRLab"
    depends on EGR_WIFI_UI
config EGR_WIFI_PASSWORD
    string "Haslo WPA2 (min. 8 znakow; puste = siec otwarta)"
    default "zmien-to-haslo"
    depends on EGR_WIFI_UI
endmenu
```

## Rewizje/EGRLab-v2/firmware/sdkconfig.defaults
```kconfig
CONFIG_ESPTOOLPY_FLASHSIZE_32MB=y
CONFIG_ESPTOOLPY_OCT_FLASH=y
CONFIG_ESPTOOLPY_FLASHFREQ_80M=y
CONFIG_SPIRAM=y
CONFIG_SPIRAM_MODE_OCT=y
CONFIG_SPIRAM_SPEED_80M=y
CONFIG_SPIRAM_USE_MALLOC=y
CONFIG_SPIRAM_MEMTEST=y
CONFIG_FREERTOS_HZ=1000
CONFIG_ESP_DEFAULT_CPU_FREQ_MHZ_240=y
CONFIG_ESP_CONSOLE_UART_DEFAULT=y
CONFIG_FATFS_LFN_HEAP=y
CONFIG_EGR_ACTIVE_TEST=n
CONFIG_EGR_SAMPLE_HZ=2000
CONFIG_EGR_WIFI_UI=n
```

## Rewizje/EGRLab-v4/firmware/main/Kconfig.projbuild
```kconfig
menu "EGRLab"
config EGR_ACTIVE_TEST
    bool "Wlacz TEST po odbiorze sprzetu i kalibracji"
    default n
config EGR_SAMPLE_HZ
    int "Zadana czestotliwosc probkowania; kwalifikuj czasy na sprzecie"
    range 1000 4000
    default 2000
config EGR_ADC_SOFTWARE_MODE
    bool "AD7606B w software mode (zworki OS[2:0] = 111, zakres per kanal)"
    default y
    help
      Wymaga ukladu AD7606B i zworek OS[2:0] ustawionych na 111. Daje zakres
      +-2,5 V na kanale masy czujnika i odczyt jedna ramka 128-bit.
      Wylacz, jesli masz zwykly AD7606: wtedy wszystkie kanaly pracuja na
      +-10 V, a odczyt idzie osmioma ramkami 16-bit. Tryb jest wybierany
      swiadomie przy kompilacji, a nie zgadywany w czasie pracy.
config EGR_WIFI_UI
    bool "SoftAP z podgladem i przyciskami na telefonie"
    default n
    depends on EGR_ACTIVE_TEST
config EGR_WIFI_SSID
    string "SSID punktu dostepowego"
    default "EGRLab"
    depends on EGR_WIFI_UI
config EGR_WIFI_PASSWORD
    string "Haslo WPA2 (min. 8 znakow; puste = siec otwarta)"
    default "zmien-to-haslo"
    depends on EGR_WIFI_UI
endmenu
```

## Rewizje/EGRLab-v6.3-m1/firmware/main/Kconfig.projbuild
```kconfig
menu "EGRLab"
config EGR_CORE_ONLY
    bool "Tylko uruchomienie ESP32 / PSRAM / SD na M1, bez akwizycji"
    default n
config EGR_TEMP_PRESENT
    bool "Moduly MAX31856 wlutowane (M1: U9/U10 na SPI3, CS GPIO8 / GPIO16)"
    default n
config EGR_CAN_PRESENT
    bool "CAN TCAN1051V (M1: odbior GPIO18, tylko nasluch)"
    default n
config EGR_ACTIVE_TEST
    bool "Wlacz TEST (IBT-2) po odbiorze sprzetu i kalibracji"
    depends on EGR_TEMP_PRESENT && !EGR_CORE_ONLY
    default n
config EGR_SAMPLE_HZ
    int "Zadana czestotliwosc probkowania; kwalifikuj czasy na sprzecie"
    range 1000 10000
    default 2000
    help
      F-05 (bez zmian w 6.3-m1): start 2 kS/s przy SPI 1 MHz. Kwalifikacja 10 kS/s wymaga
      EGR_ADC_SPI_HZ = 4000000 (transfer 128 bit 32 us + BUSY do ok. 9,9 us przy OS x8) i pomiaru opoznien.
      Bufor PSRAM 8 MiB wystarcza na ok. 21 s przy 10 kS/s (105 s przy 2 kS/s).
config EGR_ADC_SOFTWARE_MODE
    bool "AD7606B w software mode (OS[2:0] = 111 na stale na M1, zakres per kanal)"
    default y
    help
      M-02: M1 ma OS = 111 na stale, wewnetrzne odniesienie, +-10 V. Daje zakres
      +-2,5 V na kanale masy czujnika i odczyt jedna ramka 128-bit.
      Wylacz tylko dla zwyklego AD7606: wtedy wszystkie kanaly pracuja na
      +-10 V, a odczyt idzie osmioma ramkami 16-bit.
config EGR_PWM_HZ
    int "Czestotliwosc PWM mostka IBT-2 (BTS7960: najwyzej 25 kHz)"
    range 100 25000
    default 1000
    help
      M-05: RPWM GPIO1 / LPWM GPIO21 (LEDC, 10 bit), kierunek = ktory PWM pracuje.
      1 kHz jak w 6.2-s1; zmiana wymaga ponownej kwalifikacji pomiaru pradu (CH6 probkowany 2 kS/s).
config EGR_SW_CURRENT_LIMIT
    bool "Programowe ograniczenie pradu silnika z CH6 (M-06, do potwierdzenia)"
    default y
    help
      M1 nie ma sprzetowego okna OC ani zatrzasku (D-M1-4). Gdy |I| z CH6 przekroczy limit w dwoch
      kolejnych probkach (1 ms przy 2 kS/s), zadanie akwizycji zdejmuje DRIVE_EN i oba PWM, zapisuje
      zdarzenie overcurrent, a TEST konczy sie FAULT. W LOGGER zdarzenie tylko informuje (pradem steruje ECU).
      Wylaczenie zostawia jedynie limit z profilu (current_limit <= 3,5 A, sprawdzany w zadaniu safety).
config EGR_SW_CURRENT_LIMIT_MA
    int "Limit pradu [mA]"
    depends on EGR_SW_CURRENT_LIMIT
    range 1000 9000
    default 8000
    help
      Tor INA240 z REF1 = VS, REF2 = GND jest liniowy do ok. +-9 A; F1 na M1 ma 7,5 A.
config EGR_DRIVE_WDT_MS
    int "Watchdog zadania safety (TWDT, panika) [ms]"
    range 50 2000
    default 200
config EGR_RTC_WDT_MS
    int "Watchdog RTC (reset systemu) [ms]"
    range 300 10000
    default 1000
config EGR_SD_SYNC_MS
    int "Okres fsync plikow sesji [ms] (M-10: brak PFAIL_N, tyle danych moze przepasc przy zaniku zasilania)"
    range 250 2000
    default 1000
config EGR_WIFI_UI
    bool "SoftAP z podgladem i przyciskami na telefonie"
    default n
    depends on EGR_ACTIVE_TEST
config EGR_WIFI_SSID
    string "SSID punktu dostepowego"
    default "EGRLab"
    depends on EGR_WIFI_UI
config EGR_WIFI_PASSWORD
    string "Haslo WPA2 (min. 8 znakow; puste = siec otwarta)"
    default "zmien-to-haslo"
    depends on EGR_WIFI_UI
config EGR_ADC_SPI_HZ
    int "AD7606B SPI clock Hz (qualify on hardware)"
    range 1000000 8000000
    default 1000000
config EGR_SD_KHZ
    int "SD SPI clock kHz (sustained write acceptance required)"
    range 2000 10000
    default 4000
endmenu
```
